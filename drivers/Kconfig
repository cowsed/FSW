## drivers/Kconfig
```kconfig
# Copyright (c) 2025 Launch Initiative
# SPDX-License-Identifier: Apache-2.0

menu "Drivers"
rsource "sensor/Kconfig"
rsource "adc/Kconfig"
rsource "gnss/Kconfig"
rsource "modem/Kconfig"

endmenu
```

## dts/bindings/modem/hoperf,rfm9Xw.yaml
```yaml
# Common fields for hoperf rfm9Xw radio chips
include: [spi-device.yaml]

description: HopeRF RFM9XW radio module

compatible: "hoperf,rfm9xw"

properties:
  "#io-channel-cells":
    type: int
    required: true
  name:
    type: string

  power-amplifier:
    type: string
    default: "RfmPowerAmplifierSelection_RFO"
    description: |
      RfmPowerAmplifierSelection_RFO:     RFO Pin: Max power of +14dBm
      RfmPowerAmplifierSelection_PaBoost: PA_BOOST Pin: Max power of +20dBm
      This setting can be reconfigured at runtime.
    enum:
      - "RfmPowerAmplifierSelection_RFO"
      - "RfmPowerAmplifierSelection_PaBoost"

  reset-gpios:
    type: phandle-array
    description: GPIO connection chip reset. If not supplied, functionality can be mimiced by physically removing power from the chip

  dio0-gpios:
    type: phandle-array
    description: GPIO connection for DIO0. Functionality described by `dio0-mapping`
  dio1-gpios:
    type: phandle-array
    description: GPIO connection for DIO1. Functionality described by `dio1-mapping`
  dio2-gpios:
    type: phandle-array
    description: GPIO connection for DIO2. Functionality described by `dio2-mapping`
  dio3-gpios:
    type: phandle-array
    description: GPIO connection for DIO3. Functionality described by `dio3-mapping`
  dio4-gpios:
    type: phandle-array
    description: GPIO connection for DIO4. Functionality described by `dio4-mapping`
  dio5-gpios:
    type: phandle-array
    description: GPIO connection for DIO5. Functionality described by `dio5-mapping`

  dio0-mapping:
    type: string
    default: "RfmDio0Mapping_Packet_PayloadReadyPacketSent"
    description: |
      Mapping of DIO 0 pin. 
      The meaning of the mapping changes depending on what mode the radio is in (Packet,Continous,LoRa)
      Ensure that the mode here agrees with `data-mode` and `long-range-mode`.
      If you change modes at runtime, check these mappings as well.
      Continous Mode:
      - RfmDio0Mapping_Continuous_SyncAddressTxReady:  SyncAddress in Rx mode, TxReady in Tx mode, Nothing in all other modes.
      - RfmDio0Mapping_Continuous_RssiPreambleDetect:  Rssi/PreambleDetect in Rx mode, Nothing in all other modes.
      - RfmDio0Mapping_Continuous_RxReadyTxReady:      RxReady in Rx mode, TxReady in Tx mode,  Nothing in all other modes.
      - RfmDio0Mapping_Continuous_Nothing:             Nothing in all modes.
      Packet Mode:
      - RfmDio0Mapping_Packet_PayloadReadyPacketSent: PayloadReady in Rx mode, PacketSent in Tx mode, Nothing in all other modes.
      - RfmDio0Mapping_Packet_RxCrcOk:                CrcOk in Rx mode, Nothing in all other modes.
      - RfmDio0Mapping_Packet_Nothing:                Nothing in all modes.
      - RfmDio0Mapping_Packet_TempChangeLowBat:       Nothing in Sleep mode, TempChange/LowBat in all other modes
      This setting can be reconfigured at runtime
    enum:
      - "RfmDio0Mapping_Continuous_SyncAddressTxReady"
      - "RfmDio0Mapping_Continuous_RssiPreambleDetect"
      - "RfmDio0Mapping_Continuous_RxReadyTxReady"
      - "RfmDio0Mapping_Continuous_Nothing"
      - "RfmDio0Mapping_Packet_PayloadReadyPacketSent"
      - "RfmDio0Mapping_Packet_RxCrcOk"
      - "RfmDio0Mapping_Packet_Nothing"
      - "RfmDio0Mapping_Packet_TempChangeLowBat"
```

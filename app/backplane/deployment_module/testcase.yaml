## app/backplane/deployment_module/testcase.yaml
```yaml
sample:
  description:
  name: deployment-module
common:
  build_only: true
  integration_platforms:
    - native_sim
tests:
  backplane.deployment_mod.default: {}
  backplane.deployment_mod.debug:
    extra_overlay_confs:
      - debug.conf
```
